/*   Code for the Small SNAPONAIR.COM communicator
 *   Dr CADIC Philippe pcadic@gmail.com
 *   www.snaponair.com
 */

#include <Wire.h>
#include <Adafruit_SSD1306.h>
#include <Adafruit_GFX.h>

// OLED display TWI address
#define OLED_ADDR   0x3C
#define ANALOG_PIN_0 36

int analog_value = 0;

// SNAP ON AIR LOGO
const unsigned char llooggoo [] = {
0x00, 0x00, 0x00, 0x00, 0x00, 0x00, 0x00, 0x00, 0x00, 0x00, 0x00, 0x00, 0x00, 0x00, 0x00, 0x00,
0x00, 0x00, 0x00, 0x00, 0x00, 0x00, 0x00, 0x00, 0x00, 0x00, 0x01, 0x00, 0x00, 0x00, 0x00, 0x00,
0x00, 0x00, 0x00, 0x00, 0x00, 0x00, 0x00, 0x00, 0x00, 0x00, 0x07, 0x40, 0x00, 0x00, 0x00, 0x00,
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0x00, 0x00, 0x00, 0x00, 0x00, 0x00, 0x00, 0x00, 0x00, 0x00, 0x00, 0x00, 0x00, 0x00, 0x00, 0x00
};

// LORA LOGO
const unsigned char loralogo [] = {
0x00, 0x00, 0x00, 0x00, 0x00, 0x00, 0x00, 0x00, 0x00, 0x00, 0x00, 0x00, 0x00, 0x00, 0x00, 0x00,
0x00, 0x00, 0x00, 0x00, 0x00, 0x00, 0x00, 0x00, 0x00, 0x00, 0x00, 0x00, 0x00, 0x00, 0x00, 0x00,
0x00, 0x00, 0x00, 0x00, 0x00, 0x00, 0x00, 0x00, 0x00, 0x00, 0x00, 0x00, 0x00, 0x00, 0x00, 0x00,
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0x00, 0x00, 0x00, 0x00, 0x00, 0x00, 0x00, 0x00, 0x00, 0x00, 0x00, 0x00, 0x00, 0x00, 0x00, 0x00
};

// Different values of the keyboard / 5 keys
// right 1107 , left = 1080, ok = 2738, up = 0 , down = 384
// Keyboard Matrix 
char kb1[11] = "1234567890";
char kb2[11] = "AZERTYUIOP";
char kb3[11] = "QSDFGHJKLM";
char kb4[11] = "WXCVBN?./!";
char kb5[5] = "s_dr";

// We define the button PIN / The case when you have buttons directly puting a +3v on digital pins
// Low: not pressed / HIGH pressed

int BUT1 = 23;
int BUT2 = 19;
int BUT3 = 18;


Adafruit_SSD1306 display(-1);

#if (SSD1306_LCDHEIGHT != 64)
#error("Height incorrect, please fix Adafruit_SSD1306.h!");
#endif


// function to display starting keyboard
void printkeyboard(int roww, int coll, String theline) { 

  int len; // Will be used to substring theline and display only the 21 last chars
 display.clearDisplay();

  Serial.println("Print Keyboard Function entered"); 
 
 for (int i = 0; i < 11; i++) {
  display.setTextColor(WHITE); // Letter color by default 
  // we check if the key to highlight is on this line else we stay white on black
  if (coll==1 && i==(roww-1)){// We highlight the KEY
       display.setTextColor(BLACK, WHITE);
    }
  
   display.setCursor(30+(i-1)*8,16);  // set the position of the cursor in X and Y
   display.print(kb1[i]);
  };
  
 for (int i = 0; i < 11; i++) {
   display.setTextColor(WHITE); // Letter color by default 
  // we check if the key to highlight is on this line else we stay white on black
  if (coll==2 && i==(roww-1)){// We highlight the KEY
       display.setTextColor(BLACK, WHITE);
    }
   display.setCursor(30+(i-1)*8,26);  // set the position of the cursor in X and Y
   display.print(kb2[i]);
  };
  
 for (int i = 0; i < 11; i++) {
   display.setTextColor(WHITE); // Letter color by default 
  // we check if the key to highlight is on this line else we stay white on black
  if (coll==3 && i==(roww-1)){// We highlight the KEY
       display.setTextColor(BLACK, WHITE);
    }
   display.setCursor(30+(i-1)*8,36);  // set the position of the cursor in X and Y
   display.print(kb3[i]);
  };

 for (int i = 0; i < 11; i++) {
   display.setTextColor(WHITE); // Letter color by default 
  // we check if the key to highlight is on this line else we stay white on black
  if (coll==4 && i==(roww-1)){// We highlight the KEY
       display.setTextColor(BLACK, WHITE);
    }
   display.setCursor(30+(i-1)*8,46);  // set the position of the cursor in X and Y
   display.print(kb4[i]);
  };

 for (int i = 0; i < 5; i++) {
  display.setTextColor(WHITE); // Letter color by default 
  // we check if the key to highlight is on this line else we stay white on black
  if (coll==5 && i==(roww-1)){// We highlight the KEY
       display.setTextColor(BLACK, WHITE);
    }
   display.setCursor(50+(i-1)*16,56);  // set the position of the cursor in X and Y
   display.print(kb5[i]);
  };

  // We now print the default message on the screen
  // Now we create the rectangle for theline
  display.drawRoundRect(0, 0, 128, 12, 2, WHITE);
  // Now we print the message
  display.setCursor(2,2);
  // Only 21 char are possible in the input type rectangle . We have to display the last 21 right char 
  len = theline.length();
  if (len >21) {
    display.print(theline.substring(len - 21, len));
    } else {
    display.print(theline);     
      }
     
  display.display();  
}


  // Function du get string from KB

String getString(){
  // We set the variables 
  int curRow=1;
  int curCol=0;
  String curString="";
  int anyChange=0; // this will be used if there is any change to redraw the screen
  int pleaseReturn=0; // if set to one, we exit function 
  int tempB1=0;
  int tempB2=0;
  int tempB3=0;

  //Serial.println("Init B1B2B3 as input"); 
 
    // We prepare and set the buttons for INPUT mode
   pinMode(BUT1, INPUT);   
   pinMode(BUT2, INPUT);   
   pinMode(BUT3, INPUT);   

  // If pressed, we change the position on the keyboard, and we refresh
  tempB1 = digitalRead(BUT1);
  tempB2 = digitalRead(BUT2);
  tempB3 = digitalRead(BUT3);

  //Serial.println("digitalRead 1 2 & 3 done"); 
   
  // Loop until pleaseReturn==1
  //Serial.println("Entering GetString loop"); 


  while (1){
  // Now we wait and test is a button is pressed

    // If pressed, we change the position on the keyboard, and we refresh
  tempB1 = digitalRead(BUT1);
  tempB2 = digitalRead(BUT2);
  tempB3 = digitalRead(BUT3);


  // if direction button pressed (B1 or B2) 
  if (tempB1==HIGH){// decrease position on the keyboard
    //Serial.println("tempB1 HIGH:" +String(tempB1)); 

    --curCol;anyChange=1;
    //Serial.println("Current Col:" +String(curCol)); 
    //Serial.println("Current Row:" +String(curRow)); 
    
    // If end of line, then we go to line 
    if(curCol<0 && curRow==5 ){
      curCol=9; curRow=4;
      };
      
    if(curCol<0 && curRow==4 ){
      curCol=9; curRow=3;
      };

    if(curCol<0 && curRow==3 ){
      curCol=9; curRow=2;
      };
      
    if(curCol<0 && curRow==2 ){
      curCol=9; curRow=1;
      };

    
    };


  if (tempB3==HIGH){// decrease position on the keyboard
    //Serial.println("tempB3 HIGH:" +String(tempB3)); 
    ++curCol;anyChange=1;
    
    //Serial.println("Current Col:" +String(curCol)); 
    //Serial.println("Current Row:" +String(curRow)); 

    // If end of line, then we go to line 2
    if(curCol>9 && curRow==1 ){
      curCol=0; curRow=2;
      };
      
    if(curCol>9 && curRow==2 ){
      curCol=0; curRow=3;
      };

    if(curCol>9 && curRow==3 ){
      curCol=0; curRow=4;
      };
      
    if(curCol>9 && curRow==4 ){
      curCol=0; curRow=5;
      };

    if(curCol>3 && curRow==5 ){
      curCol=3; curRow=5;
      };
    
    };

  
  // If ok pressed we increment curString
  if (tempB2==HIGH){// We add the charateur to curString kb1[i], kb2[i], kb3[i], kb4[i], kb5[i]
      //Serial.println("tempB2 HIGH:" +String(tempB2));  
      delay(100); // We need to pause a bit to avoid multiple selection 
      
    if (curRow==1){curString=curString + kb1[curCol]; anyChange=1;};
    if (curRow==2){curString=curString + kb2[curCol]; anyChange=1;};
    if (curRow==3){curString=curString + kb3[curCol]; anyChange=1;};
    if (curRow==4){curString=curString + kb4[curCol]; anyChange=1;};
    if (curRow==5 && curCol== 1){curString=curString + " "; anyChange=1;}; // Spacebar
    if (curRow==5 && curCol== 2){curString = curString.substring(0, curString.length() - 1); anyChange=1;}; // Delete Backspace
    
    
    // if OK is pressed and also ENTER/RETURN, we must exit function and retrn the value of the string       
    if (curRow==5 && curCol== 3){ pleaseReturn=1; anyChange=1; break;}; // Return request
 
    };



  // We redraw the screen if there is a change and loop again
  if (anyChange==1){
    // redraw screen
    printkeyboard(curCol+1,curRow,curString);
    anyChange=0;
    };  

  };

  // If pleaseReturn activated we return the string to function
  display.clearDisplay();
  display.display();
  return curString;
  
  };



void setup() {



   
  // initialize and clear display
  display.begin(SSD1306_SWITCHCAPVCC, OLED_ADDR);
  display.clearDisplay();
  display.display();

  // Display logo
  display.clearDisplay();
  display.drawBitmap(0, 0, llooggoo, 128, 64, 1);
  display.display();
  delay(2000);
 
  // Terminal debug information

  Serial.begin(115200);
  delay(500); // give me time to bring up serial monitor
 
  Serial.println("First KB display"); 

  // We print the first blanck keyboard then we listen to the keyboard  
  printkeyboard(1,1,"");
  String curString=getString();
  Serial.println("Curstring= "+curString);
   
};


void display_lora(){
  display.clearDisplay();
  display.drawBitmap(0, 0, loralogo, 128, 64, 1);
  display.display();
  delay(2000);
  
  };

void display_title(){
  // Display Title and description of the Software
  display.clearDisplay();
  // display a line of text
  display.setTextSize(1);
  display.setTextColor(WHITE);
  display.setCursor(25,15);
  display.print("Tiny SnapOnAir");
  display.setCursor(27,30);
  display.print("868 Mhz LORA");
  display.setCursor(18,45);
  display.print("(C)2018 Dr CADIC");
  display.display();
  
  };


void loop() {
  
 // We wait the the instruction to display the keyboard and send a msgs mode
 // if OK is pressed from the main menu, then we go to printkeyboard and let the user type the message
 // By default , we are in receive mode 
 
 
 
   //Serial.println(waitkeypressed());
   //printkeyboard() ;
 

}

